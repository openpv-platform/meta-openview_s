/dts-v1/;
/plugin/;

/*
	This overlay will:
		1) Set the panel compatibility string to the 7 inch compatible panel structure

	For documentation on fragments see wiki: https://dev.azure.com/HeliosEngineering/Right%20Cost%20Display/_wiki/wikis/Development%20Documentation/71/Device-Tree-Overlays-for-the-RCD-BSP#
*/

/ {
	compatible = "stm32mp157a-right_cost_display-mx";

	fragment@0 {
		target = <&panel>;
		__overlay__ {
			compatible = "innolux,zj070na-01p";
		};
	};

};