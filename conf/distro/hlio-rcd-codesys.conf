## conf/distro/hlio-rcd-codesys.conf
```bitbake
#@NAME: hlio-rcd
#@DESCRIPTION: Helios Technologies Right Cost Display featuring OpenSTLinux with Weston/Wayland (with GPLv3 software)

# Original source file: meta-st-openstlinux/conf/distro/openstlinux-weston.conf

require conf/distro/include/st-default-distro-rules.inc
require conf/distro/include/st-default-distro-providers.inc
require conf/distro/include/openstlinux.inc

# =========================================================================
# Distribution definition for: hlio-rcd-codesys
# =========================================================================
DISTRO = "hlio-rcd-codesys"
DISTRO_NAME = "Helios RCD with codesys support"
DISTRO_VERSION = "1.0"

# =========================================================================
# DISTRO features
# =========================================================================
DISTRO_FEATURES:append = " opengl"
#DISTRO_FEATURES:remove = " x11 "
# with X11
PREFERRED_PROVIDER_virtual/xserver = "${@bb.utils.contains('DISTRO_FEATURES', 'x11 wayland', 'xwayland', 'xserver-xorg', d)}"

# Backend for webkit
PREFERRED_RPROVIDER_virtual/wpebackend = "wpebackend-fdo"

DISTRO_FEATURES:append = " gplv3 "

DISTRO_FEATURES:remove = " ipv6 multiarch pci nfs tmp2 3g nfc api-documentation "

DISTROOVERRIDES .= ":rt"

# =========================================================================
# Add LOCALE Support
# =========================================================================
DISTRO_FEATURES_LIBC:append = " libc-locales"
DISTRO_FEATURES:append = " ${DISTRO_FEATURES_LIBC}"
GLIBC_GENERATE_LOCALES = "en_US.UTF-8"
IMAGE_LINGUAS = "en-us"
ENABLE_BINARY_LOCALE_GENERATION = "1"
IMAGE_INSTALL:append = " glibc-gconv-utf-16 glibc-gconv-utf-7 glibc-gconv-utf-32"


DISTRO_FEATURES:append = " codesys "
```

## conf/distro/hlio-rcd-ota.conf
```bitbake
#@NAME: hlio-rcd
#@DESCRIPTION: Helios Technologies Right Cost Display featuring OpenSTLinux with Weston/Wayland (with GPLv3 software)

# Original source file: meta-st-openstlinux/conf/distro/openstlinux-weston.conf

require conf/distro/include/st-default-distro-rules.inc
require conf/distro/include/st-default-distro-providers.inc
require conf/distro/include/openstlinux.inc

# =========================================================================
# Distribution definition for: hlio-rcd-ota
# =========================================================================
DISTRO = "hlio-rcd-ota"
DISTRO_NAME = "Helios RCD Small OTA Distro"
DISTRO_VERSION = "1.0"

# =========================================================================
# DISTRO features
# =========================================================================
DISTRO_FEATURES:append = " opengl"
DISTRO_FEATURES:remove = " wayland x11 "
# with X11
# PREFERRED_PROVIDER_virtual/xserver = "${@bb.utils.contains('DISTRO_FEATURES', 'x11 wayland', 'xwayland', 'xserver-xorg', d)}"

# Backend for webkit
PREFERRED_RPROVIDER_virtual/wpebackend = "wpebackend-fdo"

DISTRO_FEATURES:append = " gplv3 "

DISTRO_FEATURES:remove = " alsa ipv6 multiarch pci wifi nfs bluetooth bluez5 gstreamer splashscreen pam kde pulseaudio "

# tmp2 3g nfc api-documentation "

DISTRO_FEATURES:remove = " systemd "
VIRTUAL-RUNTIME_init_manager = "busybox"
VIRTUAL-RUNTIME_login_manager = "busybox"

# VIRTUAL-RUNTIME_init_manager = "sysvinit"
# VIRTUAL-RUNTIME_initscripts = "initscripts"
# DISTRO_FEATURES:append = " sysvinit"

# DISTRO_FEATURES_BACKFILL_CONSIDERED_append = " systemd"
```

## conf/distro/hlio-rcd.conf
```bitbake
#@NAME: hlio-rcd
#@DESCRIPTION: Helios Technologies Right Cost Display featuring OpenSTLinux with Weston/Wayland (with GPLv3 software)

# Original source file: meta-st-openstlinux/conf/distro/openstlinux-weston.conf

require conf/distro/include/st-default-distro-rules.inc
require conf/distro/include/st-default-distro-providers.inc
require conf/distro/include/openstlinux.inc

# =========================================================================
# Distribution definition for: hlio-rcd-
# =========================================================================
DISTRO = "hlio-rcd"
DISTRO_NAME = "Helios RCD - (A Yocto Project Based ST Linux Distro)"
DISTRO_VERSION = "1.0"

# =========================================================================
# DISTRO features
# =========================================================================
DISTRO_FEATURES:append = " opengl"
#DISTRO_FEATURES:remove = " x11 "
# with X11
PREFERRED_PROVIDER_virtual/xserver = "${@bb.utils.contains('DISTRO_FEATURES', 'x11 wayland', 'xwayland', 'xserver-xorg', d)}"

# Backend for webkit
PREFERRED_RPROVIDER_virtual/wpebackend = "wpebackend-fdo"

DISTRO_FEATURES:append = " gplv3 "

# DISTRO_FEATURES:remove = " ipv6 multiarch pci nfs tmp2 3g nfc api-documentation "
DISTRO_FEATURES:remove = " ipv6 multiarch pci nfs tmp2 3g nfc api-documentation "
```

## conf/layer.conf
```bitbake
# We have a conf and classes directory, add to BBPATH
BBPATH .= ":${LAYERDIR}"

# We have recipes-* directories, add to BBFILES
BBFILES += "${LAYERDIR}/recipes-*/*/*.bb \
            ${LAYERDIR}/recipes-*/*/*.bbappend"

BBFILE_COLLECTIONS += "meta-hlio-rcd"
BBFILE_PATTERN_meta-hlio-rcd = "^${LAYERDIR}/"
BBFILE_PRIORITY_meta-hlio-rcd = "7"

# Set a variable to get the STM32MP MX BSP location
STM32MP_META_HLIO_RCD_BASE = "${LAYERDIR}"

# This should only be incremented on significant changes that may
# cause compatibility issues with other layers
LAYERVERSION_meta-hlio-rcd = "1"

LAYERDEPENDS_meta-hlio-rcd = "stm-st-stm32mp-mx"
LAYERSERIES_COMPAT_meta-hlio-rcd = "kirkstone"
```

## conf/machine/stm32mp1-hlio-rcd-ota.conf
```bitbake
#@TYPE: Machine
#@NAME: stm32mp15-hlio-rcd-ota
#@DESCRIPTION: Configuration for STM32CubeMX generated project
#@NEEDED_BSPLAYERS: layers/meta-openembedded/meta-oe layers/meta-openembedded/meta-python layers/meta-st/meta-hlio-rcd

# Original source file: meta-st-stm32mp-addons/conf/machine/stm32mp15-mx.conf

###########################################################################
#
# Default machine configuration sections
#
###########################################################################

require stm32mp1-hlio-rcd.conf

MACHINEOVERRIDES:remove = ":${ESP_HOSTED_VERSION}"
MACHINEOVERRIDES:append = ":ota"

# =========================================================================
# Machine features (default for stm32mp1 like)
# =========================================================================

# Consider removing some of these:
# MACHINE_FEATURES += "splashscreen"
# MACHINE_FEATURES += "watchdog"
# MACHINE_FEATURES += "${@'gpu' if d.getVar('ACCEPT_EULA_'+d.getVar('MACHINE')) == '1' else ''}"
# MACHINE_FEATURES += "m4copro"


# Fixed value ignores the ST variables above. We have to hard code this to make
# sure that the order of the partitions has rootfs at the end.
PARTITIONS_IMAGES = "rootfs"
```
